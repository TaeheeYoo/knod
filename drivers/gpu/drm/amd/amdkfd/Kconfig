## drivers/gpu/drm/amd/amdkfd/Kconfig
```kconfig
# SPDX-License-Identifier: MIT
#
# Heterogeneous system architecture configuration
#

config HSA_AMD
	bool "HSA kernel driver for AMD GPU devices"
	depends on DRM_AMDGPU && (X86_64 || ARM64 || PPC64 || (RISCV && 64BIT) || (LOONGARCH && 64BIT))
	select HMM_MIRROR
	select MMU_NOTIFIER
	select DRM_AMDGPU_USERPTR
	help
	  Enable this if you want to use HSA features on AMD GPU devices.

config HSA_AMD_SVM
	bool "Enable HMM-based shared virtual memory manager"
	depends on HSA_AMD && DEVICE_PRIVATE
	default y
	select HMM_MIRROR
	select MMU_NOTIFIER
	help
	  Enable this to use unified memory and managed memory in HIP. This
	  memory manager supports two modes of operation. One based on
	  preemptions and one based on page faults. To enable page fault
	  based memory management on most GFXv9 GPUs, set the module
	  parameter amdgpu.noretry=0.

config HSA_AMD_P2P
	bool "HSA kernel driver support for peer-to-peer for AMD GPU devices"
	depends on HSA_AMD && PCI_P2PDMA
	help
	  Enable peer-to-peer (P2P) communication between AMD GPUs over
	  the PCIe bus. This can improve performance of multi-GPU compute
	  applications and libraries by enabling GPUs to access data directly
	  in peer GPUs' memory without intermediate copies in system memory.

	  This P2P feature is only enabled on compatible chipsets, and between
	  GPUs with large memory BARs that expose the entire VRAM in PCIe bus
	  address space within the physical address limits of the GPUs.

config HSA_AMD_KNOD
	bool "KNOD GPU network offload core"
	depends on HSA_AMD
	default y
	help
	  Core framework for KNOD, GPU-accelerated zero-copy network packet
	  processing on AMD GPUs.  It is built into amdgpu and cannot be a
	  module because it relies on non-exported amdgpu/amdkfd internals.

	  Say N to drop the KNOD core along with the BPF and IPsec offloads
	  layered on top of it.  If unsure, say Y.

config HSA_AMD_KNOD_BPF
	tristate "KNOD BPF"
	depends on HSA_AMD_KNOD
	help
	  GPU-accelerated XDP/BPF packet processing via KNOD.  BPF programs
	  attached in XDP mode are JIT-compiled to AMD GCN shaders and run
	  on the GPU against packets DMA'd directly into GPU memory, keeping
	  the verdict path (PASS/DROP/TX) off the host CPU.

	  If unsure, say N.

config HSA_AMD_KNOD_IPSEC
	tristate "KNOD IPsec (xfrm) full-packet offload"
	depends on HSA_AMD_KNOD && XFRM_OFFLOAD && INET_ESP
	help
	  GPU-accelerated IPsec ESP full-packet offload via KNOD.
	  Accepts xfrm SAs configured with XFRM_DEV_OFFLOAD_PACKET and
	  performs ESP parse, SA lookup, anti-replay, AES-GCM decrypt and
	  verdict writeback on the GPU.
```

## net/knod/Kconfig
```kconfig
# SPDX-License-Identifier: GPL-2.0-or-later

config KNOD
	def_bool y
	depends on NET_DEVMEM
```
